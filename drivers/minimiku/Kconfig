## drivers/minimiku/Kconfig
```kconfig
# SPDX-License-Identifier: GPL-2.0-only

menu "MiniMiku drivers"

config MINIMIKU_TEST
	tristate "MiniMiku test module"
	default m
	help
	  Build the MiniMiku test driver as a loadable kernel module.

config MINIMIKU_MP
	tristate "MiniMiku Multipurpose System driver module"
	default m
	help
	  Build the MiniMiku Multipurpose system driver as a loadable kernel module.

config MINIMIKU_HWNAME
	string "MiniMiku hardware name"
	default "MyComputer"
	help
	  Set the hardware name reported by MiniMiku Linux.

config MINIMIKU_MLOG
	bool "MiniMiku kernel logging device"
	depends on MISC_DEVICES
	default y
	help
	  Enable the MiniMiku logging subsystem.
	  Provides an independent kernel log buffer through /dev/mlog.

endmenu
```
